## examples/ecd_test/main/Kconfig.projbuild
```kconfig
menu "Application"

    config ECD_DRIVING_ACTIVE
        bool "Active Driving"
        default n
        help
            Selects active driving mode for ECD.

endmenu
```
